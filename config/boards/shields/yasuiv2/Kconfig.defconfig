## config/boards/shields/yasuiv2/Kconfig.defconfig
```kconfig
# Copyright (c) 2020 The ZMK Contributors
# SPDX-License-Identifier: MIT

if SHIELD_YASUIV2

config ZMK_KEYBOARD_NAME
    default "yasuiv2"

endif
```

## config/boards/shields/yasuiv2/Kconfig.shield
```kconfig
# Copyright (c) 2020 The ZMK Contributors
# SPDX-License-Identifier: MIT

config SHIELD_YASUIV2
   def_bool $(shields_list_contains, yasuiv2)
```
